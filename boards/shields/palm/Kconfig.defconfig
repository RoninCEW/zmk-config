## boards/shields/palm/Kconfig.defconfig
```kconfig
if SHIELD_PALM_LEFT

# Name must be less than 16 characters long!
config ZMK_KEYBOARD_NAME
    default "Ronin's Keyboard"

config ZMK_SPLIT_ROLE_CENTRAL
    default y

endif

if SHIELD_PALM_LEFT || SHIELD_PALM_RIGHT

config ZMK_SPLIT
    default y

endif
```
